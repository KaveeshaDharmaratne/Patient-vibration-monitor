#include "display_manager.h"
#include "config/hardware_config.h"


static const uint8_t logo_bmp[1024] = {
    // logo data safe wibe 
    0x00, 0x00, 0x00, 0x00, 0x00, 0x00, 0x00, 0x00, 0x00, 0x00, 0x00, 0x00, 0x00, 0x00, 0x00, 0x00,
    0x00, 0x00, 0x00, 0x00, 0x00, 0x00, 0x00, 0x00, 0x00, 0x00, 0x00, 0x00, 0x00, 0x00, 0x00, 0x00,
    0x00, 0x00, 0x00, 0x00, 0x00, 0x00, 0x00, 0x00, 0x00, 0x00, 0x00, 0x00, 0x00, 0x00, 0x00, 0x00,
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    0x00, 0x00, 0x00, 0x00, 0x00, 0x00, 0x00, 0x00, 0x00, 0x00, 0x00, 0x00, 0x00, 0x00, 0x00, 0x00
};
DisplayManager::DisplayManager() {
    display = new Adafruit_SSD1306(SCREEN_WIDTH, SCREEN_HEIGHT, &Wire, OLED_RESET);
    loadingProgress = 0;
    wifiStatus = false;
    alertStatus = false;
    sensorStatus = false;
    communicationStatus = false;
}

DisplayManager::~DisplayManager() {
    if (display) {
        delete display;
    }
}

bool DisplayManager::begin() {
    if (!display->begin(SSD1306_SWITCHCAPVCC, 0x3C)) {
        return false;
    }
    display->clearDisplay();
    display->setTextColor(SSD1306_WHITE);
    display->display();
    return true;
}

void DisplayManager::showLogo() {
    display->clearDisplay();
  display->drawBitmap(0, 0, logo_bmp, 122, 64, 1);
  display->display();
  vTaskDelay(2000/portTICK_PERIOD_MS);
}

void DisplayManager::updateLoadingProgress(const char* status, int progress) {
    display->clearDisplay();
    display->setTextSize(1);
    display->setCursor(0, 10);
    display->println(status);
    drawLoadingBar(progress);
    display->display();
}

void DisplayManager::drawLoadingBar(int progress) {
    int barWidth = SCREEN_WIDTH - 20;
    int barHeight = 10;
    int x = 10;
    int y = 40;
    
    display->drawRect(x, y, barWidth, barHeight, SSD1306_WHITE);
    display->fillRect(x + 2, y + 2, (barWidth - 4) * progress / 100, barHeight - 4, SSD1306_WHITE);
}

void DisplayManager::showMainScreen(float ax, float ay, float az, const char* date, const char* time, int batteryLevel) {
    display->clearDisplay();
    
    // Draw the outer frame
    display->drawRect(0, 0, SCREEN_WIDTH, SCREEN_HEIGHT, SSD1306_WHITE);
    
    // Draw header with battery and status icons
    drawHeader();
    drawBattery(batteryLevel);
    drawStatusIcons();
    
    // Draw date and time
   // drawDateTime(date, time);
    
    // Draw sensor data
    drawSensorData(ax, ay, az);
    
    display->display();
}

void DisplayManager::drawBattery(int percentage) {
    // Draw battery outline
    display->drawRect(95, 2, 30, 10, SSD1306_WHITE);
    display->drawRect(124, 4, 2, 6, SSD1306_WHITE);
    display->fillRect(97, 4, (26 * percentage / 100), 6, SSD1306_WHITE);
    
    // Draw percentage
    display->setTextSize(1);
    display->setCursor(70, 3);
    display->print(percentage);
    display->print("%");
}

void DisplayManager::drawHeader() {
    display->drawFastHLine(0, 15, SCREEN_WIDTH, SSD1306_WHITE);
}

void DisplayManager::drawDateTime(const char* date, const char* time) {
    display->setTextSize(1);
    display->setCursor(5, 5);
    display->print(date);
    display->print(" ");
    display->print(time);
}

void DisplayManager::drawSensorData(float ax, float ay, float az) {
    display->setTextSize(1);
    display->setCursor(5, 20);
    display->print("Acc X: ");
    display->println(ax);
    
    display->setCursor(5, 30);
    display->print("Acc Y: ");
    display->println(ay);
    
    display->setCursor(5, 40);
    display->print("Acc Z: ");
    display->println(az);
}

void DisplayManager::drawStatusIcons() {
    // Draw status icons at the top right
    int iconSize = 8;
    int startX = 5;
    int y = 3;
    
    // WiFi status
    if (wifiStatus) {
        display->fillRect(startX, y, iconSize, iconSize, SSD1306_WHITE);
    } else {
        display->drawRect(startX, y, iconSize, iconSize, SSD1306_WHITE);
    }
    
    // Alert status
    if (alertStatus) {
        display->fillTriangle(startX + 15, y + iconSize,
                            startX + 15 + iconSize/2, y,
                            startX + 15 + iconSize, y + iconSize,
                            SSD1306_WHITE);
    }
    
    // Sensor status
    if (sensorStatus) {
        display->fillCircle(startX + 30, y + iconSize/2, iconSize/2, SSD1306_WHITE);
    }
}

// Status setters
void DisplayManager::setWifiStatus(bool status) {
    wifiStatus = status;
}

void DisplayManager::setAlertStatus(bool status) {
    alertStatus = status;
}

void DisplayManager::setSensorStatus(bool status) {
    sensorStatus = status;
}

void DisplayManager::setCommunicationStatus(bool status) {
    communicationStatus = status;
}
void DisplayManager::updateSensorData(float ax, float ay, float az) {
    // Update only the sensor data section
    display->fillRect(0, 20, SCREEN_WIDTH, SCREEN_HEIGHT - 20, SSD1306_BLACK); // Clear sensor data area
    drawSensorData(ax, ay, az);
    display->display();
}
